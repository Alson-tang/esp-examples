## main/Kconfig.projbuild
```kconfig
menu "SoftAP Configuration"

    config ESP_WIFI_SSID
        string "WiFi SSID"
        default "Alson"
        help
            SSID (network name) for the example to connect to.

    config ESP_WIFI_PASSWORD
        string "WiFi Password"
        default "12345678"
        help
            WiFi password (WPA or WPA2) for the example to use.

    config ESP_WIFI_CHANNEL
        int "WiFi Channel"
        range 1 13
        default 6
        help
            WiFi channel (network channel) for the example to use.

    config ESP_MAX_STA_CONN
        int "Maximal STA connections"
        default 4
        help
            Max number of the STA connects to AP.

    config ESP_SOFTAP_IP
        string "SoftAP ip address"
        default "192.168.4.2"
        help
            SoftAP ip address

    config ESP_SOFTAP_NETMASK
        string "SoftAP netmask address"
        default "255.255.255.0"
        help
            SoftAP netmask address

    config ESP_SOFTAP_GATEWAY
        string "SoftAP gateway address"
        default "192.168.4.1"
        help
            SoftAP gateway address
endmenu
```
